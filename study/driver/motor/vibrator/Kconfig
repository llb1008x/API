## study/driver/motor/vibrator/Kconfig
```kconfig
config MTK_VIBRATOR
	tristate "MediaTek Vibrator driver"
	default n
	  ---help---
	  Vibrator driver support for MediaTek SOC.
	  You can customize the vibrate strength and lowest vibrate time.
	  If you want to use MediaTek Vibrator driver, say Y or M here.
	  If unsure, say N.

config GN_BSP_MTK_VIBRATOR_DRV2604L
	tristate "TI Vibrator driver"
	default n
	  ---help---
	  Vibrator driver support for TI SOC.
	  You can customize the vibrate strength and lowest vibrate time.
	  If you want to use MediaTek Vibrator driver, say Y or M here.
	  If unsure, say N.
```
